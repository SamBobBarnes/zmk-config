#include "sambobbarnes.dtsi" // The shared dtsi file is included in the overlay

// Label of the kscan node in the dtsi
&kscan0 {
    col-gpios
        = <&shifter_col 0 GPIO_ACTIVE_HIGH>
        , <&shifter_col 1 GPIO_ACTIVE_HIGH>
        , <&shifter_col 2 GPIO_ACTIVE_HIGH>
        , <&shifter_col 3 GPIO_ACTIVE_HIGH>
        , <&shifter_col 4 GPIO_ACTIVE_HIGH>
        , <&shifter_col 5 GPIO_ACTIVE_HIGH>
        , <&shifter_col 6 GPIO_ACTIVE_HIGH>
        ;
};